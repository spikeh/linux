## drivers/net/ethernet/meta/Kconfig
```kconfig
# SPDX-License-Identifier: GPL-2.0-only
#
# Meta Platforms network device configuration
#

config NET_VENDOR_META
	bool "Meta devices"
	default y
	help
	  If you have a network (Ethernet) card belonging to this class, say Y.

	  Note that the answer to this question doesn't directly affect the
	  kernel: saying N will just cause the configurator to skip all
	  the questions about Meta cards. If you say Y, you will be asked for
	  your specific card in the following questions.

if NET_VENDOR_META

config FBNIC
	tristate "Meta(R) Host Network Interface"
	default n
	depends on PCI_MSI
	depends on PTP_1588_CLOCK_OPTIONAL
	select NET_DEVLINK
	select PLDMFW
	help
	  This driver supports Meta(R) Host Network Interface.

	  To compile this driver as a module, choose M here. The module
	  will be called fbnic.  MSI-X interrupt support is required


endif # NET_VENDOR_META
```
